## blerdf_receiver/main/Kconfig.projbuild
```kconfig
menu "BleRDF Receiver System Configuration"

    config MONITORING_OUTPUT_GPIO_NO
        int "Monitoring Output GPIO No"
        default 20
        help
            GPIO number for monitoring signals

endmenu
```

## brdf_beacon/sdkconfig.defaults
```kconfig
# Hare Tortoise Clock System sdkconfig Default

CONFIG_IDF_TARGET="esp32c6"

# Cpu Freq
CONFIG_ESP32_DEFAULT_CPU_FREQ_80=y
CONFIG_ESP32_DEFAULT_CPU_FREQ_160=n
CONFIG_ESP32_DEFAULT_CPU_FREQ_240=n

# Enable C++ exceptions and set emergency pool size for exception objects
CONFIG_COMPILER_CXX_EXCEPTIONS=n

# Disable Assertions
CONFIG_OPTIMIZATION_ASSERTIONS_DISABLED=y
CONFIG_OPTIMIZATION_ASSERTION_LEVEL=0

# Compiler Optimize
CONFIG_COMPILER_OPTIMIZATION_DEFAULT=n
CONFIG_COMPILER_OPTIMIZATION_SIZE=n
CONFIG_COMPILER_OPTIMIZATION_PERF=y
CONFIG_COMPILER_OPTIMIZATION_NONE=n

# Serial flasher config
CONFIG_ESPTOOLPY_FLASHSIZE_2MB=n
CONFIG_ESPTOOLPY_FLASHSIZE_4MB=y
CONFIG_ESPTOOLPY_FLASHSIZE="4MB"

# Partition Table
CONFIG_PARTITION_TABLE_SINGLE_APP=n
CONFIG_PARTITION_TABLE_CUSTOM=y

# Enable Bluetooth
CONFIG_BT_ENABLED=y
CONFIG_BT_BLE_50_FEATURES_SUPPORTED=y
CONFIG_BT_BLE_42_FEATURES_SUPPORTED=y
#CONFIG_BT_LE_50_FEATURE_SUPPORT=y

# Disable Devices
CONFIG_SOC_DAC_SUPPORTED=n
CONFIG_SOC_TOUCH_SENSOR_SUPPORTED=n
CONFIG_SOC_WIFI_SUPPORTED=n
CONFIG_SOC_MCPWM_SUPPORTED=n

# Fat FS
CONFIG_FATFS_LFN_NONE=n
CONFIG_FATFS_LFN_HEAP=y
CONFIG_FATFS_MAX_LFN=255
CONFIG_FATFS_API_ENCODING_ANSI_OEM=n
CONFIG_FATFS_API_ENCODING_UTF_8=y
```
